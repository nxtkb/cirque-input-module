## drivers/input/Kconfig
```kconfig
config INPUT_PINNACLE2
	bool "Cirque Pinnacle 1CA027 Touch Controller Based Device"
	default y
	depends on DT_HAS_CIRQUE_PINNACLE2_ENABLED
	select GPIO
	select I2C if $(dt_compat_on_bus,$(DT_COMPAT_CIRQUE_PINNACLE2),i2c)
 	select SPI if $(dt_compat_on_bus,$(DT_COMPAT_CIRQUE_PINNACLE2),spi)
	help
	  Enable driver for Cirque Pinnacle 1CA027 tracked input device.

if INPUT_PINNACLE2

config INPUT_PINNACLE_INIT_PRIORITY
    int "Cirque Pinnacle initialization priority"
    default INPUT_INIT_PRIORITY

endif
```

## dts/bindings/behaviors/zmk,behavior-cirque-mode.yaml
```yaml
# Copyright (c) 2026 The ZMK Contributors
# SPDX-License-Identifier: MIT

description: Runtime Cirque data mode selection behavior

compatible: "zmk,behavior-cirque-mode"

include: one_param.yaml

properties:
  "#binding-cells":
    const: 1
```

## dts/bindings/behaviors/zmk,behavior-drag-scroll.yaml
```yaml
# Copyright (c) 2026 The ZMK Contributors
# SPDX-License-Identifier: MIT

description: Drag Scroll Behavior

compatible: "zmk,behavior-drag-scroll"

include: zero_param.yaml
```

## dts/bindings/behaviors/zmk,behavior-pointing-speed.yaml
```yaml
# Copyright (c) 2026 The ZMK Contributors
# SPDX-License-Identifier: MIT

description: Runtime pointing speed adjustment behavior

compatible: "zmk,behavior-pointing-speed"

include: two_param.yaml

properties:
  "#binding-cells":
    const: 2
```

## dts/bindings/behaviors/zmk,behavior-sniping.yaml
```yaml
# Copyright (c) 2026 The ZMK Contributors
# SPDX-License-Identifier: MIT

description: Sniping Behavior

compatible: "zmk,behavior-sniping"

include: zero_param.yaml
```

## dts/bindings/input/cirque,pinnacle-i2c.yaml
```yaml
description: Cirque Pinnacle 1CA027 ASIC trackpad connected through I2C

compatible: "cirque,pinnacle2"

include: ["i2c-device.yaml", "cirque,pinnacle-common.yaml"]
```

## dts/bindings/input/cirque,pinnacle-spi.yaml
```yaml
description: Cirque Pinnacle 1CA027 ASIC trackpad connected through SPI

compatible: "cirque,pinnacle2"

include: ["spi-device.yaml", "cirque,pinnacle2-common.yaml"]
```

## dts/bindings/input/cirque,pinnacle2-common.yaml
```yaml
description: Cirque Pinnacle 1CA027 ASIC trackpad

properties:
  data-ready-gpios:
    type: phandle-array
    description: |
      Data Ready (DR) GPIO pin. The DR pin is connected to Pinnacle HW_DR
      which is active high when SW_DR or SW_CC are asserted. If connected
      directly, the MCU pin should be configured as active low.

  sensitivity:
    type: string
    default: "4x"
    description: |
      ADC attenuation, 1x is the most sensitive and 4x is the least sensitive.
    enum:
      - "1x"
      - "2x"
      - "3x"
      - "4x"

  data-mode:
    type: string
    default: "relative"
    description: |
      Data output mode in which position is reported. In the relative mode
      each position is reported as relative to the last position. In the
      absolute mode absolute coordinates are reported.
    enum:
      - "absolute"
      - "relative"

  idle-packets-count:
    type: int
    default: 0
    description: |
      The number of empty packets where both X and Y are set to 0. They are
      started to be sent when a finger presence is detected missing (no touch
      detected) every 10 ms. They are stopped to be sent when a finger presence
      it detected. An application can count these packets in order to detect
      taps. When set to 0, no empty packets are sent. Supported values from 0
      to 255.

  startup-delay-ms:
    type: int
    default: 0
    description: |
      Delay initialization by this many milliseconds after the application
      starts. This can help when the MCU resets without power-cycling the
      Pinnacle controller, such as after a bootloader firmware update.

  absolute-relative-multiplier:
    type: int
    default: 1
    description: |
      Multiplier applied when converting absolute-mode coordinate deltas to
      relative pointer movement. Used only when data-mode is "absolute".

  absolute-relative-divisor:
    type: int
    default: 8
    description: |
      Divisor applied when converting absolute-mode coordinate deltas to
      relative pointer movement. Used only when data-mode is "absolute".
      Increase this value to make absolute-mode pointer movement slower.

  absolute-touch-min-z:
    type: int
    default: 1
    description: |
      Minimum absolute-mode Z pressure required to treat a sample as touching.
      Samples below this value are handled as no-touch. Increase this value to
      reduce hover or very light touch movement.

  absolute-tap-max-ms:
    type: int
    default: 250
    description: |
      Maximum touch duration in milliseconds for software tap detection in
      absolute mode. Used only when data-mode is "absolute" and
      primary-tap-enable is set.

  absolute-tap-max-movement:
    type: int
    default: 80
    description: |
      Maximum absolute-coordinate movement allowed for software tap detection
      in absolute mode. Used only when data-mode is "absolute" and
      primary-tap-enable is set.

  absolute-tap-click-ms:
    type: int
    default: 30
    description: |
      Duration in milliseconds to hold the generated mouse button down for
      software taps in absolute mode. Very short press/release pulses can be
      missed by the host or split transport.

  absolute-tap-drag-enable:
    type: boolean
    description: |
      Enable tap-drag in absolute mode. After a primary tap, a second nearby
      touch within the timeout holds the primary mouse button until lift,
      allowing text selection and dragging without a physical mouse button.

  absolute-tap-drag-timeout-ms:
    type: int
    default: 300
    description: |
      Maximum delay between a primary tap release and the second touch that
      starts tap-drag.

  absolute-tap-drag-max-movement:
    type: int
    default: 160
    description: |
      Maximum coordinate distance between the primary tap and the second touch
      that starts tap-drag.

  absolute-secondary-tap-area-width:
    type: int
    default: 0
    description: |
      Width of the lower-right software secondary-tap area in absolute
      coordinates. Set to 0 to disable secondary tap detection.

  absolute-secondary-tap-area-height:
    type: int
    default: 0
    description: |
      Height of the lower-right software secondary-tap area in absolute
      coordinates. Set to 0 to disable secondary tap detection.

  absolute-aux-tap-area-width:
    type: int
    default: 0
    description: |
      Width of the upper-left software auxiliary-tap area in absolute
      coordinates. Set to 0 to disable auxiliary tap detection.

  absolute-aux-tap-area-height:
    type: int
    default: 0
    description: |
      Height of the upper-left software auxiliary-tap area in absolute
      coordinates. Set to 0 to disable auxiliary tap detection.

  absolute-edge-motion-enable:
    type: boolean
    description: |
      In absolute mode, continue emitting pointer motion while the finger is
      held in an edge zone. This implements touchpad-style edge auto-pan
      without requiring lift-and-reposition GlideExtend behavior.

  absolute-edge-motion-zone:
    type: int
    default: 120
    description: |
      Width of each edge zone, in absolute coordinates, used by absolute edge
      motion. Set to 0 to disable edge zones.

  absolute-edge-motion-speed:
    type: int
    default: 4
    description: |
      Relative movement units emitted on each edge-motion tick.

  absolute-edge-motion-interval-ms:
    type: int
    default: 10
    description: |
      Interval in milliseconds between edge-motion ticks.

  absolute-edge-motion-start-ms:
    type: int
    default: 120
    description: |
      Delay in milliseconds after touch start before edge motion begins. This
      avoids triggering edge motion from short taps near the edge.

  absolute-right-edge-scroll-enable:
    type: boolean
    description: |
      In absolute mode, start vertical scrolling when a touch begins in the
      logical right edge zone. The scroll mode remains locked until lift.

  absolute-top-edge-scroll-enable:
    type: boolean
    description: |
      In absolute mode, start horizontal scrolling when a touch begins in the
      logical top edge zone. The scroll mode remains locked until lift.

  absolute-scroll-zone:
    type: int
    default: 120
    description: |
      Width of the edge-scroll zones, in logical absolute coordinates. The
      logical coordinates include the same swap/invert transform used for
      absolute-mode pointer movement.

  absolute-scroll-divisor:
    type: int
    default: 80
    description: |
      Coordinate delta divisor used when converting absolute edge movement to
      wheel ticks. Increase this value to make edge scrolling slower.

  glide-extend-enable:
    type: boolean
    description: |
      In the relative mode enable Cirque GlideExtend, allowing drag motion to
      continue after reaching a pad edge by lifting and repositioning the
      finger.

  sleep-mode-enable:
    type: boolean
    description: |
      Enable sleep mode, allowing the hardware to enter a lower power mode
      after 5 seconds with no finger detected.

  clipping-enable:
    type: boolean
    description: |
      In the absolute mode enable clipping of reported coordinates which are
      outside of the active range.

  active-range-x-min:
    type: int
    default: 128
    description: |
      The minimum X value which can be reported.

  active-range-x-max:
    type: int
    default: 1920
    description: |
      The maximum X value which can be reported.

  active-range-y-min:
    type: int
    default: 64
    description: |
      The minimum Y value which can be reported.

  active-range-y-max:
    type: int
    default: 1472
    description: |
      The maximum Y value which can be reported.

  scaling-enable:
    type: boolean
    description: |
      In the absolute mode enable scaling of coordinates according to
      the specified resolution for X and Y axises. The scaling is applied only
      when the clipping is enabled.

  scaling-x-resolution:
    type: int
    default: 1024
    description: Resolution for the X axis.

  scaling-y-resolution:
    type: int
    default: 1024
    description: Resolution for the Y axis.

  invert-x:
    type: boolean
    description: |
      In relative mode, set the hardware X data invert bit. In absolute mode,
      invert the software-generated relative X delta.

  invert-y:
    type: boolean
    description: |
      In relative mode, set the hardware Y data invert bit. Absolute mode does
      not apply this flag to the software-generated relative Y delta.

  primary-tap-enable:
    type: boolean
    description: |
      In relative mode, enable the hardware primary tap buttons. In absolute
      mode, enable software tap areas for primary, secondary, and auxiliary
      button reporting.

  swap-xy:
    type: boolean
    description: |
      In relative mode, set the hardware X/Y swap bit. In absolute mode, swap
      the software-generated relative deltas and logical edge coordinates.
      This is equivalent to rotating coordinates by 90 degrees.
```

## dts/bindings/input_processors/zmk,input-processor-drag-scroll.yaml
```yaml
# Copyright (c) 2026 The ZMK Contributors
# SPDX-License-Identifier: MIT

description: Conditional drag-scroll input processor

compatible: "zmk,input-processor-drag-scroll"

include: ip_two_param.yaml

properties:
  track-remainders:
    type: boolean
  speed-multipliers:
    type: array
    default: [1, 1, 3]
  speed-divisors:
    type: array
    default: [2, 1, 2]
  initial-speed-index:
    type: int
    default: 1
  scroll-min-step:
    type: int
    default: 0
  scroll-max-delta:
    type: int
    default: 0
  scroll-curve-deadzone:
    type: int
    default: 2
  scroll-curve-accel-multiplier:
    type: int
    default: 1
  scroll-curve-accel-divisor:
    type: int
    default: 16
  scroll-inertia:
    type: boolean
  scroll-inertia-interval-ms:
    type: int
    default: 16
  scroll-inertia-decay-percent:
    type: int
    default: 70
  invert-scroll:
    type: boolean
    description: |
      Invert wheel and horizontal-wheel events handled by this processor.
  native-wheel-axis:
    type: string
    default: "vertical"
    enum:
      - "vertical"
      - "horizontal"
      - "horizontal-when-enabled"
```

## dts/bindings/input_processors/zmk,input-processor-pointer-speed.yaml
```yaml
# Copyright (c) 2026 The ZMK Contributors
# SPDX-License-Identifier: MIT

description: Runtime pointer speed input processor

compatible: "zmk,input-processor-pointer-speed"

include: ip_two_param.yaml

properties:
  track-remainders:
    type: boolean
  one-x-multiplier:
    type: int
    default: 1
  one-x-divisor:
    type: int
    default: 1
  min-percent:
    type: int
    default: 10
  max-percent:
    type: int
    default: 400
  initial-speed-position:
    type: int
    default: 50
  pointer-curve:
    type: string
    default: "linear"
    enum:
      - "linear"
      - "adaptive"
  pointer-curve-deadzone:
    type: int
    default: 2
  pointer-curve-accel-multiplier:
    type: int
    default: 1
  pointer-curve-accel-divisor:
    type: int
    default: 12
  pointer-curve-max-delta:
    type: int
    default: 120
```

## dts/bindings/input_processors/zmk,input-processor-sniping.yaml
```yaml
# Copyright (c) 2026 The ZMK Contributors
# SPDX-License-Identifier: MIT

description: Conditional sniping input processor

compatible: "zmk,input-processor-sniping"

include: ip_two_param.yaml

properties:
  track-remainders:
    type: boolean
  speed-multipliers:
    type: array
    default: [1, 1, 3]
  speed-divisors:
    type: array
    default: [2, 1, 2]
  initial-speed-index:
    type: int
    default: 1
  pointer-curve:
    type: string
    default: "linear"
    enum:
      - "linear"
      - "adaptive"
  pointer-curve-deadzone:
    type: int
    default: 2
  pointer-curve-accel-multiplier:
    type: int
    default: 1
  pointer-curve-accel-divisor:
    type: int
    default: 12
  pointer-curve-max-delta:
    type: int
    default: 120
```
